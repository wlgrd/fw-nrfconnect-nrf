## tests/production/thingy91/testcase.yaml
```yaml
tests:
  production.thingy91:
    platform_whitelist: nrf52840_pca10056 nrf9160_pca20035
    tags: thingy91 production_test
```

## west.yml
```yaml
# The west manifest file for the nRF Connect SDK (NCS).
#
# The per-installation west configuration file specifies the location of this
# manifest file. The "path" option in the [manifest] section of .west/config
# defines the folder that contains west.yml. The path is relative to the folder
# that contains .west.
#
# You can create your own manifest files and put them in any
# repository you want, to create your own custom NCS installation.
# For example, you could create a manifest file in your own
# out-of-tree application directory, which would pull the nrf repository
# in as an ordinary project.
#
# You can pass your manifest repositories to west init when creating a
# new NCS installation. See the west documentation for more
# information.

west:
  url: https://github.com/zephyrproject-rtos/west
  revision: master

manifest:
  defaults:
    remote: ncs

  remotes:
      # nRF Connect SDK base URL.
    - name: ncs
      url-base: https://github.com/NordicPlayground
    - name: jtguggedal
      url-base: https://github.com/jtguggedal
    - name: joakimtoe
      url-base: https://github.com/joakimtoe
    - name: wlgrd
      url-base: https://github.com/wlgrd

  # The list of external projects for the nRF Connect SDK.
  #
  projects:
    - name: fw-nrfconnect-zephyr
      path: zephyr
      west-commands: scripts/west-commands.yml
      revision: 8dd9fa0c045ba51b8abc2adce78615467d1de088
      remote: wlgrd
    - name: fw-nrfconnect-mcuboot
      path: mcuboot
      revision: 45b99f43c7ed3469c1a2df56dbb135f8ebfa50c6
      remote: joakimtoe
    - name: nrfxlib
      path: nrfxlib
      revision: eea93e6bbb49381c077231357d52cd321fad4f9e
      remote: jtguggedal

  self:
    path: nrf
```
